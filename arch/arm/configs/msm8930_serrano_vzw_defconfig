## arch/arm/configs/msm8930_serrano_vzw_defconfig
```kconfig
CONFIG_MACH_SERRANO_VZW=y
CONFIG_VZW_VOLUME=y
CONFIG_2MIC_QUP_I2C=y
CONFIG_2MIC_ES305=y
CONFIG_2MIC_QUP_I2C_GSBI11=y
CONFIG_DOCK_EN=y
CONFIG_SEC_DISABLE_HARDRESET=y
CONFIG_AUTHENTEC_VPNCLIENT_INTERCEPTOR=m
CONFIG_KEYBOARD_CYPRESS_TOUCH=y
```

## arch/arm/hotplug/Kconfig
```kconfig
config INTELLI_PLUG
        bool "Enable intelli-plug cpu hotplug driver"
        default n
        help
          Generic Intelli-plug cpu hotplug driver for ARM SOCs

config ALUCARD_HOTPLUG
	bool "Enable alucard-hotplug cpu hotplug driver"
	default n
	help
	  Generic Alucard-hotplug cpu hotplug driver for ARM SOCs

config MSM_HOTPLUG
	bool "MSM hotplug driver"
	depends on HOTPLUG_CPU
	default n
	help
	  The MSM hotplug driver controls on-/offlining of additional cores based
	  on current cpu load.
```

## drivers/input/keyboard/melfas_touchkey/Kconfig
```kconfig
#
# Melfas touchkey configuration
#

config KEYBOARD_MELFAS_TOUCHKEY
	tristate "Melfas touch keypad support"
	default n
	help
	  Say Y here if you want to use the Cypress touch keypad.

	  To compile this driver as a module, choose M here: the
	  module will be called melfas_touchkey.
```

## drivers/motor/Kconfig
```kconfig
#
# Immersion TouchSense Player driver configuration
#
menuconfig VIBETONZ
        tristate "Vibetonz"
        default n
        help
          Say Y to enable Vibetonz support.

config MOTOR_DRV_MAX77693
	tristate "Maxim MAX77693 motor"
	default n

	depends on MFD_MAX77693

#
# vibrator controlled by PMIC regualtor configuration
#
menuconfig MSM_VIBRATOR
        tristate "MSM_VIBRATOR"
        default n
        help
          Say Y to enable MSM_VIBRATOR support.

#
# Immersion TouchSense Player driver configuration
#
menuconfig MOTOR_DRV_TSP5000
        tristate "MOTOR_DRV_TSP5000"
        default n
        help
          Say Y to enable MOTOR_DRV_TSP5000 support.
```

## drivers/sensors/Kconfig
```kconfig
menuconfig INPUT_YAS_SENSORS
	bool "Sensors Support"
	help
	  Say Y to enable Sensors support.  This allows control of supported
	  Sensors.

if INPUT_YAS_SENSORS
source "drivers/sensors/geomagnetic/Kconfig"
endif # INPUT_YAS_SENSORS
source "drivers/sensors/optical/Kconfig"

menuconfig GRIP_SENSOR
	bool "Sensors Support"
	help
	  Say Y to enable grip Sensors support.  This allows control of supported
	  Sensors.

if GRIP_SENSOR
config SENSORS_AD7146
	tristate "ANALOG DEVICES AD7146 Multi-Proximity Sensor"
	depends on I2C && SYSFS
	help
	  If you say yes here you get support for the AD7146
	  multi proximity sensor.
	  This driver can also be built as a module.  If so, the module
	  will be called ad7146.
endif
config SENSORS_CORE
         bool "sensors_core"
         depends on I2C

config SENSOR_USE_SYMLINK
         bool "sensors_symlink"
         depends on I2C
config INPUT_BMP180
        depends on I2C && SYSFS
        tristate "BMP180 digital pressure sensor"
        help
          If you say yes here you get support for the Bosch Sensortec
          BMP180 digital pressure sensor.
config INPUT_YAS_ORIENTATION
	tristate "YAS Orientation Sensor"
	depends on I2C

#Acclerometer

config SENSORS_K2DH
	tristate "K2DH acceleration sensor support"
	depends on I2C
        default n
	help
	  Say Y here if you use K2DH.
	  This option enables accelerometer sensors using
	  STM K2DH in K2DH device driver.
	  Say N here if you do not use K2DH.


config SENSOR_K2DH_INPUTDEV
	bool "K2DH acceleration sensor input dev support"
	depends on SENSORS_K2DH
        default n
	help
	  Say Y here if you use K2DH.
	  This option enables accelerometer sensor using
	  K3DH device driver.
	  Say N here if you do not use K2DH.

config SENSORS_ALPS
	tristate "Sensors Alps"
	default n
	help
	  Say Y here to enable debugging messages for power supply class
	  and drivers.

config SENSORS_ALPS_MAG_HSCDTD008A
	depends on I2C
	tristate "hscd alps mag"
	default n
	help
	  This option enables hscd alps mag.

config SENSORS_ALPS_ACC_BMA254
	depends on I2C
	tristate "bma254 accel"
	default n
	help
	  This option enables and bma254 accel driver based on alps mag.

config BMA254_SMART_ALERT
	depends on I2C
	tristate "bma254 smart alert"
	default n
	help
	  This option enables bma254 smart alert function.


config INPUT_YAS_ACCELEROMETER

	tristate "YAS Acceleration Sensor"

	depends on I2C



config OPTICAL_TAOS_TRITON

	depends on I2C

	tristate "TAOS ambient light and proximity input device"

	default n



config OPTICAL_TAOS_TMD2672X

	depends on I2C

	tristate "TAOS ambient proximity input device without light sensor"

	default n



config YAS_ACC_DRIVER_BMA250

	tristate "YAS Acceleration Sensor- BMA250"

	depends on I2C



config INPUT_YAS_ACCELEROMETER_POSITION

		int "YAS Acceleration Sensor Mounting Position on Board"

		depends on INPUT_YAS_ACCELEROMETER

		default "0"

		help

           Chip mounting position (pin 1).

              0: top, upper-left

              1: top, upper-right

              2: top, lower-right

              3: top, lower-left

              4: bottom, upper-left

              5: bottom, upper-right

              6: bottom, lower-right

              7: bottom, lower-left
```

## drivers/sensors/grip/Kconfig
```kconfig
config SENSORS_AD7146
	tristate "ANALOG DEVICES AD7146 Multi-Proximity Sensor"
	depends on I2C && SYSFS
	help
	  If you say yes here you get support for the AD7146
	  multi proximity sensor.
	  This driver can also be built as a module.  If so, the module
	  will be called ad7146.
```

## drivers/sensors/optical/Kconfig
```kconfig
config OPTICAL_BH1721
         tristate "Rohm bh1721 Optical Sensor"
         depends on I2C
config INPUT_CM3663
	depends on I2C && GENERIC_GPIO
	tristate "Capella CM3663 ambient light and proximity sensor"
	default n
	help
	  This option enables proximity & light sensors using CM3663 driver.
config OPTICAL_AL3201
         tristate "Rohm bh1721 Optical Sensor"
         depends on I2C

config OPTICAL_GP2AP020A00F
	depends on I2C
	bool "Sharp GP2AP020A00F driver"
	default n

config OPTICAL_TAOS_TRITON
	depends on I2C
	tristate "TAOS ambient light and proximity input device"
	default n

config OPTICAL_TAOS_TMD3782
	depends on I2C
	tristate "TAOS RGBC sensor input device"
	default n
config PROXIMITY_SENSOR
	tristate "proximity_sensor"
	default n
config SENSORS_GP2A030
	depends on I2C
	tristate "GP2AP030 driver"
	default n
	help
	  This option enables proximity & light sensors using gp2ap030 driver.
```

## drivers/sensors_alps/Kconfig
```kconfig
#
# Sensors core device.
#


config SENSORS_ALPS
	tristate "Sensors Alps"
	default n
	help
	  Say Y here to enable debugging messages for power supply class
	  and drivers.

config SENSORS_ALPS_MAG_HSCDTD008A
	depends on I2C
	tristate "hscd alps mag"
	default n
	help
	  This option enables hscd alps mag.

config SENSORS_ALPS_ACC_BMA254
	depends on I2C
	tristate "bma254 accel"
	default n
	help
	  This option enables and bma254 accel driver based on alps mag.

config BMA254_SMART_ALERT
	depends on I2C
	tristate "bma254 smart alert"
	default n
	help
	  This option enables bma254 smart alert function.

config PROXIMITY_SENSOR
	tristate "proximity_sensor"
	default n

config SENSORS_CORE
         bool "sensors_core"
         depends on I2C

config SENSOR_USE_SYMLINK
         bool "sensors_symlink"
         depends on I2C
```

## drivers/ultrasonic/Kconfig
```kconfig
#
# Sensor  drivers configuration
#
menuconfig ULTRASONIC_SENSOR
	bool "ultrasonic Sensor devices"
	help
	  Say Y here, and a list of sensors drivers will be displayed.
	  Everything that didn't fit into the other categories is here. This option
	  doesn't affect the kernel.

	  If unsure, say Y.

config SENSORS_ULTRASONIC_SENSORTEC
	tristate "ultrasonic sensor support"
	default n
	help
	  If you say yes here you get support for Validity's
	  ultrasonic sensor sensortec.
```
