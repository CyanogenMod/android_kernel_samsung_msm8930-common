## arch/arm/configs/msm8930_lt02_eng_defconfig
```kconfig
CONFIG_PROFILING=y
CONFIG_OPROFILE=y
CONFIG_KPROBES=y
CONFIG_MSM_TZ_LOG=y
CONFIG_MSM_RPM_LOG=y
CONFIG_MSM_RPM_STATS_LOG=y
CONFIG_MSM_RPM_RBCPR_STATS_LOG=y
CONFIG_DEBUG_GPIO=y
CONFIG_USB_GADGET_DEBUG_FILES=y
CONFIG_MMC_PERF_PROFILING=y
CONFIG_DEBUG_KMEMLEAK=y
CONFIG_DEBUG_KMEMLEAK_DEFAULT_OFF=y
CONFIG_DEBUG_SPINLOCK=y
CONFIG_DEBUG_MUTEXES=y
CONFIG_DEBUG_MEMORY_INIT=y
CONFIG_FAULT_INJECTION=y
CONFIG_FAILSLAB=y
CONFIG_FAIL_PAGE_ALLOC=y
CONFIG_FAULT_INJECTION_DEBUG_FS=y
CONFIG_FAULT_INJECTION_STACKTRACE_FILTER=y
CONFIG_DEBUG_PAGEALLOC=y
CONFIG_ENABLE_DEFAULT_TRACERS=y
CONFIG_SEC_DEBUG_IRQ_EXIT_LOG=y
CONFIG_SEC_DEBUG_DOUBLE_FREE=y
CONFIG_BLOCK=y
CONFIG_BLK_DEV_IO_TRACE=y
CONFIG_DEBUG_PAGEALLOC=y
CONFIG_SLUB_DEBUG=y
CONFIG_SAMSUNG_DEBUG_DISPLAY=y
# Overriding the rooting prevention feature as disable on ENG build
# CONFIG_SEC_RESTRICT_ROOTING is not set
# CONFIG_SEC_RESTRICT_SETUID is not set
# CONFIG_SEC_RESTRICT_FORK is not set
# CONFIG_SEC_RESTRICT_ROOTING_LOG is not set
```

## arch/arm/configs/msm8930_lt02_sea_defconfig
```kconfig
CONFIG_MACH_LT02_SPR=y
CONFIG_AUTHENTEC_VPNCLIENT_INTERCEPTOR=m
CONFIG_FB_MDP4_ENHANCE=y
CONFIG_MACH_LT02_SEA=y
CONFIG_MSM_VIBRATOR=y
# CONFIG_NO_GPIO_EXPANDER_FPGA is not set
# CONFIG_IR_REMOCON_FPGA is not set
# CONFIG_SEC_FPGA is not set
# CONFIG_SENSORS_AD7146 is not set
CONFIG_SENSORS_ASP01=y
```

## arch/arm/configs/msm8930_lt02_spr_defconfig
```kconfig
CONFIG_MACH_LT02_SPR=y
CONFIG_ADC_STMPE811=y
CONFIG_AUTHENTEC_VPNCLIENT_INTERCEPTOR=m
CONFIG_FB_MDP4_ENHANCE=y
```

## arch/arm/configs/msm8930_melius_att_defconfig
```kconfig
CONFIG_MACH_MELIUS_ATT=y
CONFIG_WCNSS_CCX=y
CONFIG_WCNSS_MEM_PRE_ALLOC=y
CONFIG_MUIC_AUDIO_OUTPUT_CONTROL=y
```

## arch/arm/configs/msm8930_melius_can_defconfig
```kconfig
CONFIG_MACH_MELIUS_ATT=y
CONFIG_MACH_MELIUS_CAN=y
CONFIG_MSM_AVS_HW=n
CONFIG_WCNSS_CCX=y
CONFIG_WCNSS_MEM_PRE_ALLOC=y
```

## arch/arm/configs/msm8930_melius_chnctc_3g_defconfig
```kconfig
CONFIG_MACH_MELIUS_EUR_OPEN=y
CONFIG_MACH_MELIUS_CHN_CTC=y

CONFIG_2MIC_QUP_I2C_GSBI2=y
CONFIG_WCD9304_USE_MI2S_CLK_9600=y
CONFIG_AUXPCM_INTERFACE=y
CONFIG_PCM_ROUTE_VOICE_STUB=y
CONFIG_SWITCH_DUAL_MODEM=y
# CONFIG_FM_RADIO is not set
# CONFIG_FM_SI4705 is not set
# CONFIG_RADIO_USE_MI2S is not set

#configs for modem interface
CONFIG_SEC_MODEM=y
CONFIG_GSM_MODEM_SPRD6500=y
CONFIG_SEC_DUAL_MODEM_MODE=y
CONFIG_LINK_DEVICE_SPI=y
CONFIG_WORKQUEUE_FRONT=y

CONFIG_SERIAL_MSM=y
CONFIG_SERIAL_MSM_CONSOLE=y

CONFIG_RTC_AUTO_PWRON=y
CONFIG_RTC_AUTO_PWRON_PARAM=y
```

## arch/arm/configs/msm8930_melius_chnopen_3g_defconfig
```kconfig
CONFIG_MACH_MELIUS_EUR_OPEN=y
CONFIG_MACH_MELIUS_CHN_OPEN=y
CONFIG_FM_RADIO=y
CONFIG_FM_SI4705=y
CONFIG_RADIO_USE_MI2S=y
CONFIG_RTC_AUTO_PWRON=y
CONFIG_RTC_AUTO_PWRON_PARAM=y
```

## arch/arm/configs/msm8930_melius_eur_3g_defconfig
```kconfig
CONFIG_MACH_MELIUS_EUR_OPEN=y
CONFIG_FM_RADIO=y
CONFIG_FM_SI4705=y
CONFIG_RADIO_USE_MI2S=y
CONFIG_WCNSS_CCX=y
CONFIG_MUIC_AUDIO_OUTPUT_CONTROL=y
```

## arch/arm/configs/msm8930_melius_eur_lte_defconfig
```kconfig
CONFIG_MACH_MELIUS_EUR_LTE=y
CONFIG_WCNSS_CCX=y
CONFIG_MUIC_AUDIO_OUTPUT_CONTROL=y
```

## arch/arm/configs/msm8930_melius_ktt_defconfig
```kconfig
CONFIG_MACH_MELIUS_KTT=y
CONFIG_TDMB=y
CONFIG_TDMB_VENDOR_FCI=y
CONFIG_TDMB_FC8050=y
CONFIG_TDMB_SPI=y
CONFIG_TDMB_ANT_DET=y
CONFIG_WCNSS_CCX=y
CONFIG_SEC_DEVIDE_RINGTONE_GAIN=y
CONFIG_MUIC_AUDIO_OUTPUT_CONTROL=y
```

## arch/arm/configs/msm8930_melius_lgt_defconfig
```kconfig
CONFIG_MACH_MELIUS_LGT=y
CONFIG_TDMB=y
CONFIG_TDMB_VENDOR_FCI=y
CONFIG_TDMB_FC8050=y
CONFIG_TDMB_SPI=y
CONFIG_TDMB_ANT_DET=y
# CONFIG_FM_RADIO is not set
# CONFIG_FM_SI4705 is not set
# CONFIG_RADIO_USE_MI2S is not set
CONFIG_LGUIWLAN=y
CONFIG_WCNSS_CCX=y
CONFIG_WCNSS_MEM_PRE_ALLOC=y
# CONFIG_ANDROID_RAM_CONSOLE is not set
CONFIG_SEC_DEBUG_NOCACHE_LOG_IN_LEVEL_LOW=y
CONFIG_SEC_LOG_LAST_KMSG=y


# disable qualcomm thermal monitor
# CONFIG_THERMAL_MONITOR is not set
CONFIG_SEC_DEBUG_LMK_MEMINFO=y
# CONFIG_ANDROID_LOW_MEMORY_KILLER_BASED_MEMUSAGE is not set

# RTCC v3
CONFIG_SWAP=y
CONFIG_ZSMALLOC=y
CONFIG_ZRAM=y
CONFIG_RUNTIME_COMPCACHE=y
CONFIG_KSWAPD_NOSWAP=y

CONFIG_USER_RESET_DEBUG=y
CONFIG_SEC_OOM_KILLER=y

#SOUND
CONFIG_SEC_DEVIDE_RINGTONE_GAIN=y
CONFIG_MUIC_AUDIO_OUTPUT_CONTROL=y
```

## arch/arm/configs/msm8930_melius_skt_defconfig
```kconfig
CONFIG_MACH_MELIUS_SKT=y
CONFIG_TDMB=y
CONFIG_TDMB_VENDOR_FCI=y
CONFIG_TDMB_FC8050=y
CONFIG_TDMB_SPI=y
CONFIG_TDMB_ANT_DET=y
CONFIG_SEC_DEBUG_NOCACHE_LOG_IN_LEVEL_LOW=y
CONFIG_SEC_LOG_LAST_KMSG=y
CONFIG_XFRM=y
CONFIG_XFRM_USER=y
CONFIG_INET_IPCOMP=y
CONFIG_INET_XFRM_MODE_TRANSPORT=y
CONFIG_CRYPTO_HMAC=y
CONFIG_CRYPTO_XCBC=y
CONFIG_CRYPTO_NULL=y
CONFIG_CRYPTO_MD5=y
CONFIG_CRYPTO_DES=y
CONFIG_CRYPTO_DEFLATE=y
CONFIG_WCNSS_CCX=y
CONFIG_WCNSS_MEM_PRE_ALLOC=y
CONFIG_NETFILTER=y
CONFIG_IP_NF_IPTABLES=y
CONFIG_NETFILTER_ADVANCED=y
CONFIG_SEC_DEBUG_LMK_MEMINFO=y
CONFIG_TCP_CONG_ADVANCED=y
CONFIG_TCP_CONG_BIC=y
CONFIG_DEFAULT_BIC=y
CONFIG_DEFAULT_TCP_CONG="bic"
CONFIG_USER_RESET_DEBUG=y
CONFIG_SEC_DEVIDE_RINGTONE_GAIN=y
CONFIG_MUIC_AUDIO_OUTPUT_CONTROL=y
```

## arch/arm/configs/msm8930_melius_spr_defconfig
```kconfig
CONFIG_MACH_MELIUS_SPR=y
CONFIG_RADIO_IRIS=y
CONFIG_RADIO_IRIS_TRANSPORT=m
CONFIG_WCNSS_CCX=y
CONFIG_NOVATEK_VIDEO_HD_CLK_MIPICLK_480=y
```

## arch/arm/configs/msm8930_melius_tmo_defconfig
```kconfig
CONFIG_MACH_MELIUS_TMO=y
CONFIG_WCNSS_CCX=y
CONFIG_AUTHENTEC_VPNCLIENT_INTERCEPTOR=m
```

## arch/arm/configs/msm8930_melius_usc_defconfig
```kconfig
CONFIG_MACH_MELIUS_USC=y
CONFIG_VZW_VOLUME=y
CONFIG_WCNSS_CCX=y
CONFIG_NOVATEK_VIDEO_HD_CLK_MIPICLK_480=y
```

## arch/arm/configs/msm8930_melius_vzw_defconfig
```kconfig
CONFIG_MACH_MELIUS_VZW=y
CONFIG_VZW_VOLUME=y
CONFIG_SEC_DISABLE_HARDRESET=y
CONFIG_WCNSS_CCX=y
CONFIG_AUTHENTEC_VPNCLIENT_INTERCEPTOR=m
CONFIG_SEC_PERIPHERAL_SECURE_CHK=y
```

## arch/arm/configs/msm8930_serrano_att_defconfig
```kconfig
CONFIG_MACH_SERRANO_ATT=y
CONFIG_2MIC_QUP_I2C=y
CONFIG_2MIC_ES305=y
CONFIG_2MIC_QUP_I2C_GSBI11=y
CONFIG_PM8921_CHARGER=y
CONFIG_WIRELESS_CHARGER=y
CONFIG_BATTERY_SAMSUNG=y
CONFIG_FUELGAUGE_MAX17048=y
CONFIG_CHARGER_MAX77XXX=y
CONFIG_SAMSUNG_LPM_MODE=y
CONFIG_KEYBOARD_CYPRESS_TOUCH=y
CONFIG_MFD_MAX77693=y
CONFIG_REGULATOR_MAX77693=y
```

## arch/arm/configs/msm8930_serrano_can_lte_defconfig
```kconfig
CONFIG_MACH_SERRANO_EUR_LTE=y
CONFIG_MACH_SERRANO_BMC=y
#CONFIG_BCM2079X_NFC_I2C=y
CONFIG_WCNSS_CCX=y
CONFIG_2MIC_QUP_I2C=y
#CONFIG_2MIC_ES305 is not set
#CONFIG_2MIC_QUP_I2C_GSBI11 is not set

# Battery charging and BMS
CONFIG_PM8921_BMS=y
CONFIG_PM8921_CHARGER=y
CONFIG_PM8921_SEC_CHARGER=y
CONFIG_SAMSUNG_LPM_MODE=y
# CONFIG_BATTERY_MSM is not set
CONFIG_BATTERY_MSM=n
CONFIG_USB_SWITCH_TSU6721=y

# SSWAP
CONFIG_SWAP=y
CONFIG_FRONTSWAP=y
CONFIG_ZSMALLOC_NEW=y
CONFIG_PGTABLE_MAPPING=y
CONFIG_ZSWAP=y
CONFIG_DIRECT_RECLAIM_FILE_PAGES_ONLY=n
CONFIG_INCREASE_MAXIMUM_SWAPPINESS=y
CONFIG_FIX_INACTIVE_RATIO=y
CONFIG_TIGHT_PGDAT_BALANCE=y
CONFIG_VNSWAP=y
CONFIG_SWAP_ENABLE_READAHEAD=n
```

## arch/arm/configs/msm8930_serrano_eng_defconfig
```kconfig
CONFIG_PROFILING=y
CONFIG_OPROFILE=y
CONFIG_KPROBES=y
CONFIG_MSM_TZ_LOG=y
CONFIG_MSM_RPM_LOG=y
CONFIG_MSM_RPM_STATS_LOG=y
CONFIG_MSM_RPM_RBCPR_STATS_LOG=y
CONFIG_DEBUG_GPIO=y
CONFIG_USB_GADGET_DEBUG_FILES=y
CONFIG_MMC_PERF_PROFILING=y
CONFIG_DEBUG_KMEMLEAK=y
CONFIG_DEBUG_KMEMLEAK_DEFAULT_OFF=y
CONFIG_DEBUG_SPINLOCK=y
CONFIG_DEBUG_MUTEXES=y
CONFIG_DEBUG_MEMORY_INIT=y
CONFIG_FAULT_INJECTION=y
CONFIG_FAILSLAB=y
CONFIG_FAIL_PAGE_ALLOC=y
CONFIG_FAULT_INJECTION_DEBUG_FS=y
CONFIG_FAULT_INJECTION_STACKTRACE_FILTER=y
CONFIG_DEBUG_PAGEALLOC=y
CONFIG_SLUB_DEBUG=y
CONFIG_SAMSUNG_DEBUG_DISPLAY=y
CONFIG_ENABLE_DEFAULT_TRACERS=y
CONFIG_SEC_DEBUG_IRQ_EXIT_LOG=y
CONFIG_SEC_DEBUG_DOUBLE_FREE=y
CONFIG_SAMSUNG_BATTERY_ENG_TEST=y
CONFIG_BLOCK=y
CONFIG_BLK_DEV_IO_TRACE=y
CONFIG_SEC_DEBUG_LMK_MEMINFO_VERBOSE=y

# Overriding the rooting prevention feature as disable on ENG build
# CONFIG_SEC_RESTRICT_ROOTING is not set
# CONFIG_SEC_RESTRICT_SETUID is not set
# CONFIG_SEC_RESTRICT_FORK is not set
# CONFIG_SEC_RESTRICT_ROOTING_LOG is not set

# SSWAP
CONFIG_SWAP=y
CONFIG_FRONTSWAP=y
CONFIG_ZSMALLOC_NEW=y
CONFIG_PGTABLE_MAPPING=y
CONFIG_ZSWAP=y
CONFIG_DIRECT_RECLAIM_FILE_PAGES_ONLY=n
CONFIG_INCREASE_MAXIMUM_SWAPPINESS=y
CONFIG_FIX_INACTIVE_RATIO=y
CONFIG_TIGHT_PGDAT_BALANCE=y
CONFIG_VNSWAP=y
CONFIG_SWAP_ENABLE_READAHEAD=n
```

## arch/arm/configs/msm8930_serrano_eur_3g_defconfig
```kconfig
CONFIG_MACH_SERRANO_EUR_3G=y
CONFIG_PM8921_BMS=y
CONFIG_PM8921_CHARGER=y
CONFIG_PM8921_SEC_CHARGER=y
CONFIG_SAMSUNG_LPM_MODE=y
CONFIG_USB_SWITCH_TSU6721=y
CONFIG_HID_KK_UPGRADE=y
```

## arch/arm/configs/msm8930_serrano_lra_defconfig
```kconfig
CONFIG_MACH_SERRANO_LRA=y
CONFIG_VZW_VOLUME=y
CONFIG_2MIC_QUP_I2C=y
CONFIG_2MIC_ES305=y
CONFIG_2MIC_QUP_I2C_GSBI11=y
CONFIG_DOCK_EN=y
#CONFIG_SEC_DISABLE_HARDRESET=y
#VMWARE RELATED
#CONFIG_VMWARE_MVP=y
#CONFIG_AUTHENTEC_VPNCLIENT_INTERCEPTOR=m
CONFIG_KEYBOARD_CYPRESS_TOUCH=y
#CONFIG_CHG_INCOMPATIBLE=y
#CONFIG_SEC_PERIPHERAL_SECURE_CHK=y

# Battery charging and BMS
# CONFIG_CHARGER_MAX77693=y is not set
# CONFIG_BATTERY_MSM is not set
# CONFIG_PM8921_BMS=y
# CONFIG_PM8921_SEC_CHARGER is not set
CONFIG_PM8921_CHARGER=y
CONFIG_SAMSUNG_LPM_MODE=y
CONFIG_BATTERY_SAMSUNG=y
CONFIG_CHARGER_MAX77XXX=y
CONFIG_CHARGER_MAX77803=y
CONFIG_FUELGAUGE_MAX17048=y
CONFIG_WIRELESS_CHARGER=y
CONFIG_CHG_INCOMPATIBLE=y

CONFIG_MFD_MAX77693=y
# CONFIG_MOTOR_DRV_MAX77693 is not set
CONFIG_REGULATOR_MAX77693=y

# MSM Vibrator
CONFIG_VIBETONZ=n
CONFIG_MSM_VIBRATOR=y

# SSWAP
CONFIG_SWAP=y
CONFIG_FRONTSWAP=y
CONFIG_ZSMALLOC_NEW=y
CONFIG_PGTABLE_MAPPING=y
CONFIG_ZSWAP=y
CONFIG_DIRECT_RECLAIM_FILE_PAGES_ONLY=n
CONFIG_INCREASE_MAXIMUM_SWAPPINESS=y
CONFIG_FIX_INACTIVE_RATIO=y
CONFIG_TIGHT_PGDAT_BALANCE=y
CONFIG_VNSWAP=y
CONFIG_SWAP_ENABLE_READAHEAD=n
```

## arch/arm/configs/msm8930_serrano_spr_defconfig
```kconfig
CONFIG_MACH_SERRANO_SPR=y
CONFIG_PM8921_CHARGER=y
CONFIG_SAMSUNG_LPM_MODE=y
CONFIG_BATTERY_SAMSUNG=y
CONFIG_CHARGER_MAX77XXX=y
CONFIG_CHARGER_MAX77803=y
CONFIG_FUELGAUGE_MAX17048=y
CONFIG_WIRELESS_CHARGER=y
CONFIG_2MIC_QUP_I2C=y
CONFIG_2MIC_ES305=y
CONFIG_2MIC_QUP_I2C_GSBI11=y
CONFIG_KEYBOARD_CYPRESS_TOUCH=y
CONFIG_MFD_MAX77693=y
CONFIG_REGULATOR_MAX77693=y
```

## arch/arm/configs/msm8930_serrano_usc_defconfig
```kconfig
CONFIG_MACH_SERRANO_USC=y
CONFIG_VZW_VOLUME=y
CONFIG_2MIC_QUP_I2C=y
CONFIG_2MIC_ES305=y
CONFIG_2MIC_QUP_I2C_GSBI11=y
```
