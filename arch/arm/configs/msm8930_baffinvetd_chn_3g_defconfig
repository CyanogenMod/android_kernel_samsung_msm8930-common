## arch/arm/configs/msm8930_cane_chncu_3g_defconfig
```kconfig
CONFIG_WLAN_REGION_CODE=300
CONFIG_TARGET_LOCALE_CHN=y
CONFIG_RTC_AUTO_PWRON=y
CONFIG_RTC_AUTO_PWRON_PARAM=y
CONFIG_MACH_CANE_CHN_CU=y
```

## arch/arm/configs/msm8930_cane_wilcox_eur_lte_defconfig
```kconfig
CONFIG_MACH_CANE_EUR_3G=y
CONFIG_MACH_WILCOX_EUR_LTE=y
CONFIG_DESKDOCK_DISABLE=y
CONFIG_TOUCHSCREEN_CYPRESS_TMA46X_SUPPORT_BUTTON=y
CONFIG_FB_MSM_MIPI_DSI_HX8389BDS15_TFT=y
CONFIG_FB_MSM_MIPI_HX8389B_TFT_VIDEO_QHD_PT=y
CONFIG_FB_MSM_MIPI_HX8389B_TFT_VIDEO_QHD_PT_PANEL=y
CONFIG_BACKLIGHT_IC_KTD3102=y
CONFIG_MSM_VIBRATOR=y
```

## arch/arm/configs/msm8930_crater_chnctc_3g_defconfig
```kconfig
CONFIG_MACH_MELIUS_EUR_OPEN=y
#CONFIG_MACH_MELIUS_CHN_CTC is not set
CONFIG_MACH_CRATER_CHN_CTC=y
CONFIG_WCD9304_USE_MI2S_CLK_9600=y
# CONFIG_FM_RADIO is not set
# CONFIG_FM_SI4705 is not set
# CONFIG_RADIO_USE_MI2S is not set
# CONFIG_2MIC_ES305 is not set
# CONFIG_2MIC_QUP_I2C is not set

#configs for modem interface
CONFIG_SEC_MODEM=y
CONFIG_GSM_MODEM_SPRD6500=y
CONFIG_SEC_DUAL_MODEM_MODE=y
CONFIG_LINK_DEVICE_SPI=y
CONFIG_WORKQUEUE_FRONT=y

CONFIG_SERIAL_MSM=y
CONFIG_SERIAL_MSM_CONSOLE=y
#configs for wakeup alarm
CONFIG_RTC_AUTO_PWRON=y
CONFIG_RTC_AUTO_PWRON_PARAM=y
```

## arch/arm/configs/msm8930_express2_att_defconfig
```kconfig
CONFIG_MACH_EXPRESS2_ATT=y
CONFIG_AUTHENTEC_VPNCLIENT_INTERCEPTOR=m
CONFIG_CRYPTO_NULL=y
```

## arch/arm/configs/msm8930_express_eur_lte_defconfig
```kconfig
CONFIG_MACH_EXPRESS_ATT=y
CONFIG_AUTHENTEC_VPNCLIENT_INTERCEPTOR=m
CONFIG_CRYPTO_NULL=y
```

## arch/arm/configs/msm8930_golden_att_defconfig
```kconfig
CONFIG_MACH_GOLDEN_ATT=y
CONFIG_2MIC_QUP_I2C_GSBI11=y
CONFIG_ESD_ERR_FG_RECOVERY=y
CONFIG_PM8921_CHARGER=y
CONFIG_BATTERY_SAMSUNG=y
CONFIG_CHARGER_SMB358=y
CONFIG_FUELGAUGE_MAX17048=y
CONFIG_SAMSUNG_LPM_MODE=y
```

## arch/arm/configs/msm8930_golden_tmo_defconfig
```kconfig
CONFIG_MACH_GOLDEN_TMO=y
CONFIG_2MIC_QUP_I2C_GSBI11=y
CONFIG_WCNSS_CCX=y
CONFIG_AUTHENTEC_VPNCLIENT_INTERCEPTOR=m
```

## arch/arm/configs/msm8930_golden_vzw_defconfig
```kconfig
CONFIG_MACH_GOLDEN_VZW=y
CONFIG_VZW_VOLUME=y
CONFIG_2MIC_QUP_I2C_GSBI11=y

CONFIG_ESD_ERR_FG_RECOVERY=y
CONFIG_JACK_VDD_CTRL=y
CONFIG_AUTHENTEC_VPNCLIENT_INTERCEPTOR=m
CONFIG_SEC_DISABLE_HARDRESET=y
CONFIG_SEC_PERIPHERAL_SECURE_CHK=y
```

## arch/arm/configs/msm8930_higgs_spr_defconfig
```kconfig
CONFIG_MACH_HIGGS_SPR=y
CONFIG_PM8921_CHARGER=y
CONFIG_PM8921_BMS=y
CONFIG_PM8921_SEC_CHARGER=y
```

## arch/arm/configs/msm8930_higgs_spr_rev03_defconfig
```kconfig
CONFIG_MACH_HIGGS_SPR=y
CONFIG_BATTERY_SAMSUNG=y
CONFIG_CHARGER_SMB347=y
CONFIG_FUELGAUGE_MAX17048=y
```

## arch/arm/configs/msm8930_jasper2_vzw_defconfig
```kconfig
CONFIG_MACH_JASPER2_VZW=y
CONFIG_TOUCHSCREEN_MMS136=y
CONFIG_SEC_DISABLE_HARDRESET=y
```

## arch/arm/configs/msm8930_jasper2_vzw_rev02_defconfig
```kconfig
CONFIG_MACH_JASPER2_VZW=y
CONFIG_TOUCHSCREEN_ZINITIX_BT432=y
CONFIG_SEC_DISABLE_HARDRESET=y
```

## arch/arm/configs/msm8930_ks02_ktt_defconfig
```kconfig
CONFIG_MACH_KS02_KTT=y
CONFIG_WLAN_REGION_CODE=202
CONFIG_KEYBOARD_MATRIX=n
CONFIG_KEYBOARD_PMIC8XXX=y

# disable qualcomm thermal monitor
CONFIG_THERMAL_MONITOR=n
```

## arch/arm/configs/msm8930_ks02_skt_defconfig
```kconfig
CONFIG_MACH_KS02_SKT=y
CONFIG_WLAN_REGION_CODE=201
# SKT IWLAN
CONFIG_XFRM=y
CONFIG_XFRM_USER=y
CONFIG_NET_KEY=y
CONFIG_INET_ESP=y
CONFIG_INET_IPCOMP=y
CONFIG_INET_XFRM_MODE_TRANSPORT=y
CONFIG_INET_XFRM_MODE_TUNNEL=y
CONFIG_IP_ADVANCED_ROUTER=y
CONFIG_IP_MULTIPLE_TABLES=y
CONFIG_CRYPTO=y
CONFIG_CRYPTO_HMAC=y
CONFIG_CRYPTO_XCBC=y
CONFIG_CRYPTO_NULL=y
CONFIG_CRYPTO_MD5=y
CONFIG_CRYPTO_SHA1=y
CONFIG_CRYPTO_DES=y
CONFIG_CRYPTO_AES=y
CONFIG_CRYPTO_DEFLATE=y

# disable qualcomm thermal monitor
CONFIG_THERMAL_MONITOR=n
```

## arch/arm/configs/msm8930_lt02_att_defconfig
```kconfig
CONFIG_MACH_LT02_ATT=y
CONFIG_FB_MDP4_ENHANCE=y
CONFIG_BATTERY_SAMSUNG=y
CONFIG_CHARGER_SMB358=y
CONFIG_FUELGAUGE_MAX17050=y
CONFIG_FUELGAUGE_MAX17050_COULOMB_COUNTING=y
CONFIG_SAMSUNG_LPM_MODE=y
CONFIG_DOCK_EN=y
CONFIG_USB_SWITCH_FSA9485=y
```

## arch/arm/configs/msm8930_lt02_chnctc_defconfig
```kconfig
CONFIG_MACH_LT02_TMO=y
CONFIG_MACH_LT02_CHN_CTC=y

#audio
# CONFIG_WCD9306_CODEC is not set
CONFIG_WCD9304_CODEC=y
CONFIG_WCD9304_CLK_9600=y
CONFIG_WCD9304_USE_MI2S_CLK_9600=y
CONFIG_AUXPCM_INTERFACE=y
CONFIG_PCM_ROUTE_VOICE_STUB=y
CONFIG_SWITCH_DUAL_MODEM=y
# CONFIG_2MIC_ES305 is not set
# CONFIG_2MIC_QUP_I2C is not set
# CONFIG_2MIC_QUP_I2C_GSBI2 is not set
CONFIG_SAMSUNG_JACK=y
CONFIG_EXT_SPK_AMP=y
CONFIG_EXT_EARMIC_BIAS=y

#motor
# CONFIG_VIBETONZ is not set
CONFIG_MSM_VIBRATOR=y

#configs for modem interface
# CONFIG_SEC_MODEM=y
# CONFIG_GSM_MODEM_SPRD6500=y
# CONFIG_SEC_DUAL_MODEM_MODE=y
# CONFIG_LINK_DEVICE_SPI=y
# CONFIG_WORKQUEUE_FRONT=y

# CONFIG_SERIAL_MSM=y
# CONFIG_SERIAL_MSM_CONSOLE=y

CONFIG_FB_MSM_MIPI2LVDS_VX5B3D_TFT_VIDEO_WSVGA_PT_PANEL=y
CONFIG_SAMSUNG_CMC624=n

CONFIG_RTC_AUTO_PWRON=y
CONFIG_RTC_AUTO_PWRON_PARAM=y

#configs for ppp
CONFIG_PPP_FILTER=y
CONFIG_PPP_ASYNC=y
CONFIG_PPP_SYNC_TTY=y

# touch
# CONFIG_TOUCHSCREEN_MXT224S is not set
# CONFIG_TOUCHSCREEN_SYNAPTICS_I2C_RMI is not set
# CONFIG_TOUCHSCREEN_MXTS is not set
# CONFIG_TOUCHSCREEN_MXT224S_NEW is not set
# CONFIG_TOUCHSCREEN_LT02_BT532 is not set
CONFIG_TOUCHSCREEN_ZINITIX_BT532=y

CONFIG_SENSOR_LT02_CTC=y
CONFIG_SENSOR_USE_SYMLINK=y
CONFIG_INPUT_YAS_SENSORS=y
CONFIG_INPUT_YAS_MAGNETOMETER=y
CONFIG_YAS_MAG_DRIVER_YAS532=y
CONFIG_SENSORS_K3DH=y
CONFIG_SENSOR_K3DH_INPUTDEV=y
CONFIG_INPUT_YAS_ORIENTATION=y
CONFIG_GRIP_SENSOR=y
CONFIG_SENSORS_ASP01=y
# CONFIG_SENSORS_AD7146 is not set
# CONFIG_PROXIMITY_SENSOR is not set
CONFIG_SENSORS_CORE=y
CONFIG_OPTICAL_GP2AP020A00F=y

# CONFIG_MOTOR_DRV_MAX77693 is not set
# CONFIG_BCM2079X_NFC_I2C is not set
# CONFIG_MSM_ACTUATOR is not set

CONFIG_WCNSS_CCX=y

CONFIG_FB_MDP4_ENHANCE=y
```
